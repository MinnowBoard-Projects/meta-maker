## conf/layer.conf
```bitbake
BPATH := "${BBPATH}:${LAYERDIR}"
BBFILES := "${BBFILES} ${LAYERDIR}/recipes-*/*/*.bb \
            ${LAYERDIR}/recipes-*/*/*.bbappend"
BBFILE_COLLECTIONS += "maker"
BBFILE_PATTERN_maker := "^${LAYERDIR}/"
BBFILE_PRIORITY_maker = "6"
LAYERDEPENDS_maker = "core openembedded-layer meta-python intel-iot-mw"
```
